## app/boards/imx8mp_evk_mimx8ml8_adsp.conf
```kconfig
CONFIG_IMX8M=y
CONFIG_HAVE_AGENT=n
CONFIG_FORMAT_CONVERT_HIFI3=n
CONFIG_KPB_FORCE_COPY_TYPE_NORMAL=n
CONFIG_COVERAGE=y
CONFIG_COVERAGE_DUMP=y
#CONFIG_ZEPHYR_NATIVE_DRIVERS=y
CONFIG_DMA=y
CONFIG_DMA_NXP_SDMA=y
CONFIG_LOG=y
CONFIG_ZEPHYR_LOG=y
CONFIG_TRACE=n
```

## src/arch/xtensa/configs/imx8x_defconfig
```kconfig
CONFIG_IMX8X=y
CONFIG_HAVE_AGENT=n

CONFIG_TRACE=y                                                                                                                                
CONFIG_TRACEV=y
CONFIG_TRACEE=y
CONFIG_TRACEM=y
```
